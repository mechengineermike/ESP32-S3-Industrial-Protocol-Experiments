## firmware/ethernet_status/sdkconfig.defaults
```kconfig
CONFIG_IDF_TARGET="esp32s3"
CONFIG_EXAMPLE_USE_SPI_ETHERNET=y
CONFIG_EXAMPLE_USE_INTERNAL_ETHERNET=n
CONFIG_EXAMPLE_SPI_ETHERNETS_NUM=1
CONFIG_EXAMPLE_USE_W5500=y
CONFIG_EXAMPLE_ETH_SPI_HOST=1
CONFIG_EXAMPLE_ETH_SPI_SCLK_GPIO=13
CONFIG_EXAMPLE_ETH_SPI_MOSI_GPIO=11
CONFIG_EXAMPLE_ETH_SPI_MISO_GPIO=12
CONFIG_EXAMPLE_ETH_SPI_CLOCK_MHZ=20
CONFIG_EXAMPLE_ETH_SPI_CS0_GPIO=14
CONFIG_EXAMPLE_ETH_SPI_INT0_GPIO=10
CONFIG_EXAMPLE_ETH_SPI_PHY_RST0_GPIO=9
CONFIG_EXAMPLE_ETH_SPI_PHY_ADDR0=1
```

## firmware/opcua_probe/sdkconfig.defaults
```kconfig
CONFIG_IDF_TARGET="esp32s3"
CONFIG_ESPTOOLPY_FLASHSIZE_16MB=y
CONFIG_PARTITION_TABLE_SINGLE_APP_LARGE=y
CONFIG_EXAMPLE_USE_SPI_ETHERNET=y
CONFIG_EXAMPLE_USE_INTERNAL_ETHERNET=n
CONFIG_EXAMPLE_SPI_ETHERNETS_NUM=1
CONFIG_EXAMPLE_USE_W5500=y
CONFIG_EXAMPLE_ETH_SPI_HOST=1
CONFIG_EXAMPLE_ETH_SPI_SCLK_GPIO=13
CONFIG_EXAMPLE_ETH_SPI_MOSI_GPIO=11
CONFIG_EXAMPLE_ETH_SPI_MISO_GPIO=12
CONFIG_EXAMPLE_ETH_SPI_CLOCK_MHZ=20
CONFIG_EXAMPLE_ETH_SPI_CS0_GPIO=14
CONFIG_EXAMPLE_ETH_SPI_INT0_GPIO=10
CONFIG_EXAMPLE_ETH_SPI_PHY_RST0_GPIO=9
CONFIG_EXAMPLE_ETH_SPI_PHY_ADDR0=1
CONFIG_SPIRAM=y
CONFIG_SPIRAM_MODE_OCT=y
CONFIG_SPIRAM_USE_MALLOC=y
CONFIG_SPIRAM_MALLOC_ALWAYSINTERNAL=4096
CONFIG_SPIRAM_TRY_ALLOCATE_WIFI_LWIP=y
CONFIG_SPIRAM_MALLOC_RESERVE_INTERNAL=32768

CONFIG_COMPILER_OPTIMIZATION_SIZE=y
CONFIG_COMPILER_OPTIMIZATION_ASSERTIONS_DISABLE=y
CONFIG_LOG_DEFAULT_LEVEL_WARN=y
```
